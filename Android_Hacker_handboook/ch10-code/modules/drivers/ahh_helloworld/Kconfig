## Android_Hacker_handboook/ch10-code/modules/drivers/ahh_helloworld/Kconfig
```kconfig
config AHH_HELLOWORLD
	tristate "Android Hacker's Handbook Hello World module"
	default m
	help
	  say M to compile it as a module
```

## Android_Hacker_handboook/ch10-code/modules/drivers/ahh_setuid/Kconfig
```kconfig
config AHH_SETUID
	tristate "Android Hacker's Handbook setuid Backdoor module"
	default m
	help
	  say M to compile it as a module
```
